## bazel/tests/downstream_project/boards/vendor/custom_sim/Kconfig
```kconfig
config BOARD_NATIVE_SIM
	bool
	default y if BOARD_CUSTOM_SIM

config CUSTOM_SIM_BOARD_FEATURE
	bool "Custom sim board feature"
	default n
```

## bazel/tests/downstream_project/boards/vendor/custom_sim/Kconfig.custom_sim
```kconfig
config BOARD_CUSTOM_SIM
	select SOC_POSIX
	select BOARD_NATIVE_SIM
	select CUSTOM_SIM_BOARD_FEATURE
```

## bazel/tests/downstream_project/boards/vendor/custom_sim/Kconfig.defconfig
```kconfig
if BOARD_CUSTOM_SIM
config BUILD_OUTPUT_BIN
	default n
config BUILD_OUTPUT_EXE
	default y
endif
```

## bazel/tests/downstream_project/boards/vendor/custom_sim/board.yml
```yaml
board:
  name: custom_sim
  full_name: Custom Native Simulator
  vendor: vendor
  socs:
  - name: native
```

## bazel/tests/downstream_project/modules/sample_mod/Kconfig
```kconfig
config SAMPLE_MOD_ENABLED
	bool "Enable sample module"
	default y

config SAMPLE_MOD_VALUE
	int "Sample module integer value"
	default 42
```

## bazel/tests/downstream_project/modules/sample_mod/dts/bindings/vendor/vendor,sample-dev.yaml
```yaml
description: Sample downstream device
compatible: "vendor,sample-dev"
properties:
  sample-prop:
    type: int
    required: true
```

## dts/bindings/sensor/st,lsm6dsk320x-common.yaml
```yaml
# Copyright (c) 2025 STMicroelectronics
# SPDX-License-Identifier: Apache-2.0

description: |
    LSM6DSK320X shares the LSM6DSV320X register map (only WHO_AM_I differs), so
    properties and values match st,lsm6dsv320x. When setting the accel-range,
    accel-odr, gyro-range, gyro-odr properties in a .dts or .dtsi file you may
    include lsm6dsv320x.h and use the macros defined there.

include: st,lsm6dsv320x-common.yaml

examples:
  - |
    #include <zephyr/dt-bindings/sensor/lsm6dsv320x.h>

    lsm6dsk320x: lsm6dsk320x@0 {
      /* ... */

      accel-range = <LSM6DSV320X_DT_FS_8G>;
      accel-odr = <LSM6DSVXXX_DT_ODR_AT_60Hz>;
      gyro-range = <LSM6DSV320X_DT_FS_4000DPS>;
      gyro-odr = <LSM6DSVXXX_DT_ODR_AT_60Hz>;
    };
```

## dts/bindings/sensor/st,lsm6dsk320x-i2c.yaml
```yaml
# Copyright (c) 2025 STMicroelectronics
# SPDX-License-Identifier: Apache-2.0

description: |
    STMicroelectronics LSM6DSK320X 6-axis IMU (Inertial Measurement Unit) sensor
    accessed through I2C bus

compatible: "st,lsm6dsk320x"

include: ["i2c-device.yaml", "st,lsm6dsk320x-common.yaml"]
```

## dts/bindings/sensor/st,lsm6dsk320x-spi.yaml
```yaml
# Copyright (c) 2025 STMicroelectronics
# SPDX-License-Identifier: Apache-2.0

description: |
    STMicroelectronics LSM6DSK320X 6-axis IMU (Inertial Measurement Unit) sensor
    accessed through SPI bus

compatible: "st,lsm6dsk320x"

include: ["spi-device.yaml", "st,lsm6dsk320x-common.yaml"]
```
