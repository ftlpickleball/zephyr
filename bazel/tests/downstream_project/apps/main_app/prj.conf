## sysbuild.conf
```
# Optional sysbuild configuration
```

## prj.conf
```kconfig
CONFIG_SAMPLE_MOD_VALUE=11
```

## app.overlay
```dts
/ {
    sample_dev: sample-dev {
        compatible = "vendor,sample-dev";
        status = "okay";
#ifdef __DTS__
        sample-prop = <200>;
#else
        sample-prop = <999>;
#endif
    };
};
```

## src/main.c
```c
#include <zephyr/kernel.h>
#include <zephyr/devicetree.h>
#include "sample_mod.h"

int main(void) {
#if DT_NODE_EXISTS(DT_NODELABEL(sample_dev))
    return sample_mod_get() + DT_PROP(DT_NODELABEL(sample_dev), sample_prop);
#else
    return sample_mod_get();
#endif
}
```
